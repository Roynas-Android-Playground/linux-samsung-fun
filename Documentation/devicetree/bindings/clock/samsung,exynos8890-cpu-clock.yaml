## Documentation/devicetree/bindings/clock/samsung,exynos8890-cpu-clock.yaml
```yaml
# SPDX-License-Identifier: (GPL-2.0-only OR BSD-2-Clause)
%YAML 1.2
---
$id: http://devicetree.org/schemas/clock/samsung,exynos8890-cpu-clock.yaml#
$schema: http://devicetree.org/meta-schemas/core.yaml#

title: Samsung Exynos8890 aggregate CPU clocks

maintainers:
  - Krzysztof Kozlowski <krzk@kernel.org>

description: |
  The provider exposes one aggregate clock for each Exynos8890 CPU cluster.
  A set-rate operation owns the complete characterized BUS-PLL safe-switch,
  divider, PLL-lock and switch-back transaction. Member names are explicit
  mappings for the immutable Exynos8890 calibration table and must remain in
  the order shown below.

properties:
  compatible:
    const: samsung,exynos8890-cpu-clock

  '#clock-cells':
    const: 1

  clocks:
    minItems: 38
    maxItems: 38

  clock-names:
    items:
      - const: apollo-pll
      - const: apollo-pll-user
      - const: apollo-bus-user
      - const: apollo-mux
      - const: apollo-root
      - const: apollo-switch-mux
      - const: apollo-switch-div
      - const: apollo-switch-gate
      - const: mongoose-pll
      - const: mongoose-pll-user
      - const: mongoose-bus-user
      - const: mongoose-mux
      - const: mongoose-root
      - const: mongoose-switch-mux
      - const: mongoose-switch-div
      - const: mongoose-switch-gate
      - const: APOLLO_PLL
      - const: APOLLO_DIV_ACLK_APOLLO
      - const: APOLLO_DIV_PCLK_APOLLO
      - const: APOLLO_DIV_ATCLK_APOLLO
      - const: APOLLO_DIV_PCLK_DBG_APOLLO
      - const: APOLLO_DIV_CNTCLK_APOLLO
      - const: APOLLO_DIV_APOLLO_PLL
      - const: APOLLO_DIV_SCLK_PROMISE_APOLLO
      - const: APOLLO_DIV_APOLLO_RUN_MONITOR
      - const: MNGS_PLL
      - const: MNGS_DIV_MNGS
      - const: MNGS_DIV_ACLK_MNGS
      - const: MNGS_DIV_PCLK_MNGS
      - const: MNGS_DIV_ATCLK_MNGS_CORE
      - const: MNGS_DIV_PCLK_DBG_MNGS
      - const: MNGS_DIV_CNTCLK_MNGS
      - const: MNGS_DIV_MNGS_PLL
      - const: MNGS_DIV_SCLK_PROMISE_MNGS
      - const: MNGS_DIV_ATCLK_MNGS_SOC
      - const: MNGS_DIV_ATCLK_MNGS_CSSYS_TRACECLK
      - const: MNGS_DIV_ATCLK_MNGS_ASYNCATB_CAM1
      - const: MNGS_DIV_ATCLK_MNGS_ASYNCATB_AUD

  samsung,apollo-sysreg:
    description: Phandle to the Apollo cluster system-register syscon.
    $ref: /schemas/types.yaml#/definitions/phandle

  samsung,mongoose-sysreg:
    description: Phandle to the Mongoose cluster system-register syscon.
    $ref: /schemas/types.yaml#/definitions/phandle

  samsung,apollo-cmu:
    description: |
      Apollo CMU containing the characterized SMPL control register.
    $ref: /schemas/types.yaml#/definitions/phandle

  samsung,mongoose-cmu:
    description: |
      Mongoose CMU containing the characterized SMPL control register.
    $ref: /schemas/types.yaml#/definitions/phandle

required:
  - compatible
  - '#clock-cells'
  - clocks
  - clock-names
  - samsung,apollo-sysreg
  - samsung,mongoose-sysreg
  - samsung,apollo-cmu
  - samsung,mongoose-cmu

additionalProperties: false
```

## Documentation/devicetree/bindings/clock/samsung,exynos8890-nfc-clock.yaml
```yaml
# SPDX-License-Identifier: (GPL-2.0-only OR BSD-2-Clause)
%YAML 1.2
---
$id: http://devicetree.org/schemas/clock/samsung,exynos8890-nfc-clock.yaml#
$schema: http://devicetree.org/meta-schemas/core.yaml#

title: Samsung Exynos8890 NFC reference clock output

maintainers:
  - Krzysztof Kozlowski <krzk@kernel.org>

description: |
  The Exynos8890 PMU routes the 26 MHz TCXO to the external NFC clock pin
  through two complementary controls in PMU_DEBUG1.

properties:
  compatible:
    const: samsung,exynos8890-nfc-clock

  '#clock-cells':
    const: 0

  clocks:
    maxItems: 1

  samsung,pmu-syscon:
    description: Phandle to the Exynos8890 PMU syscon.
    $ref: /schemas/types.yaml#/definitions/phandle

required:
  - compatible
  - '#clock-cells'
  - clocks
  - samsung,pmu-syscon

additionalProperties: false
```

## Documentation/devicetree/bindings/cpufreq/samsung,exynos8890-cpufreq.yaml
```yaml
# SPDX-License-Identifier: (GPL-2.0-only OR BSD-2-Clause)
%YAML 1.2
---
$id: http://devicetree.org/schemas/cpufreq/samsung,exynos8890-cpufreq.yaml#
$schema: http://devicetree.org/meta-schemas/core.yaml#

title: Samsung Exynos8890 dual-cluster CPU frequency scaling

maintainers:
  - Krzysztof Kozlowski <krzk@kernel.org>

description: |
  Exynos8890 CPU frequency policy coordinates the aggregate Apollo and
  Mongoose clocks, S2MPS16 voltage rails and MIF minimum-frequency constraints.
  Clock-register and EMA transactions belong to the CPU clock provider. The
  driver refuses to operate while the APM Cortex-M3 owns closed-loop DVFS.

properties:
  compatible:
    const: samsung,exynos8890-cpufreq

  clocks:
    minItems: 2
    maxItems: 2

  clock-names:
    items:
      - const: apollo
      - const: mongoose

  apollo-supply: true
  mongoose-supply: true

  samsung,pmu:
    description: Phandle to the Exynos PMU syscon used to verify APM ownership.
    $ref: /schemas/types.yaml#/definitions/phandle

  samsung,apm:
    description: Phandle to the APM ownership provider kept in direct-PMIC mode.
    $ref: /schemas/types.yaml#/definitions/phandle

  samsung,mif-devfreq:
    description: |
      Phandle to the MIF devfreq provider receiving CPU floor votes.  CPU and
      MIF tables remain in Hz; the driver converts the vote at the generic
      devfreq QoS boundary, whose frequency ABI is kHz.
    $ref: /schemas/types.yaml#/definitions/phandle

required:
  - compatible
  - clocks
  - clock-names
  - apollo-supply
  - mongoose-supply
  - samsung,pmu
  - samsung,apm
  - samsung,mif-devfreq

additionalProperties: false
```

## Documentation/devicetree/bindings/devfreq/samsung,exynos8890-bus.yaml
```yaml
# SPDX-License-Identifier: (GPL-2.0-only OR BSD-2-Clause)
%YAML 1.2
---
$id: http://devicetree.org/schemas/devfreq/samsung,exynos8890-bus.yaml#
$schema: http://devicetree.org/meta-schemas/core.yaml#

title: Samsung Exynos8890 calibrated bus devfreq

maintainers:
  - Chanwoo Choi <cw00.choi@samsung.com>
  - Krzysztof Kozlowski <krzk@kernel.org>

description: |
  Native devfreq consumers for the Exynos8890 INT, CAM and DISP aggregate
  clocks. Characterized OPP rates and voltages are loaded from the SoC ECT
  calibration data, so they are intentionally not duplicated in DT.

properties:
  compatible:
    enum:
      - samsung,exynos8890-int-devfreq
      - samsung,exynos8890-cam-devfreq
      - samsung,exynos8890-disp-devfreq

  clocks:
    maxItems: 1

  clock-names:
    const: bus

  vdd-supply:
    description: Regulator for this aggregate clock domain

  '#cooling-cells':
    const: 2

required:
  - compatible
  - clocks
  - clock-names
  - vdd-supply

additionalProperties: false

examples:
  - |
    #include <dt-bindings/clock/samsung,exynos8890-cmu.h>

    devfreq-int {
        compatible = "samsung,exynos8890-int-devfreq";
        clocks = <&cmu_top CLK_DVFS_INT>;
        clock-names = "bus";
        vdd-supply = <&buck4>;
        #cooling-cells = <2>;
    };
...
```

## Documentation/devicetree/bindings/devfreq/samsung,exynos8890-mif-devfreq.yaml
```yaml
# SPDX-License-Identifier: (GPL-2.0-only OR BSD-2-Clause)
%YAML 1.2
---
$id: http://devicetree.org/schemas/devfreq/samsung,exynos8890-mif-devfreq.yaml#
$schema: http://devicetree.org/meta-schemas/core.yaml#

title: Samsung Exynos8890 native MIF devfreq policy

maintainers:
  - Ivaylo Ivanov <ivo.ivanov.ivanov1@gmail.com>

description: |
  The Exynos8890 MIF devfreq device is a policy consumer of the dedicated DMC
  owner. Frequencies are expressed in Hz. Voltage values describe the vendor
  baseline table for compatibility with the common policy parser; the DMC
  obtains finalized per-OPP voltages from immutable calibration data and owns
  the regulator transaction.

properties:
  compatible:
    const: samsung,exynos8890-mif-devfreq

  samsung,dmc:
    $ref: /schemas/types.yaml#/definitions/phandle
    description: Dedicated Exynos8890 DMC transaction owner.

  devfreq_type:
    const: mif

  devfreq_domain_name:
    const: dvfs_mif

  opp_list_length:
    $ref: /schemas/types.yaml#/definitions/uint32
    const: 12

  opp_list:
    $ref: /schemas/types.yaml#/definitions/uint32-array
    minItems: 36
    maxItems: 36
    description: Twelve index, frequency-Hz and baseline-voltage-uV tuples.

  freq_info:
    $ref: /schemas/types.yaml#/definitions/uint32-array
    minItems: 6
    maxItems: 6

  use_get_dev:
    const: "false"

  polling_ms:
    $ref: /schemas/types.yaml#/definitions/uint32
    const: 0

  gov_name:
    const: performance

  use_reg:
    const: "false"

  use_reg_dummy:
    const: "false"

  reg_name:
    const: vdd_mif

  volt_info:
    $ref: /schemas/types.yaml#/definitions/uint32-array
    minItems: 4
    maxItems: 4

  use_tmu:
    const: "false"

  use_cl_dvfs:
    const: "false"

  use_sw_clk:
    const: "false"

required:
  - compatible
  - samsung,dmc
  - devfreq_type
  - devfreq_domain_name
  - opp_list_length
  - opp_list
  - freq_info
  - use_get_dev
  - polling_ms
  - gov_name
  - use_reg
  - use_reg_dummy
  - reg_name
  - volt_info
  - use_tmu
  - use_cl_dvfs
  - use_sw_clk

additionalProperties: false

examples:
  - |
    devfreq-mif {
        compatible = "samsung,exynos8890-mif-devfreq";
        samsung,dmc = <&dmc>;
        devfreq_type = "mif";
        devfreq_domain_name = "dvfs_mif";
        opp_list_length = <12>;
        opp_list = <0 1794000000 968750
                    1 1716000000 950000
                    2 1539000000 900000
                    3 1352000000 875000
                    4 1144000000 875000
                    5 1014000000 875000
                    6 845000000 875000
                    7 676000000 875000
                    8 546000000 875000
                    9 421000000 875000
                    10 286000000 875000
                    11 208000000 875000>;
        freq_info = <1794000000 421000000 0 1794000000
                     421000000 1794000000>;
        use_get_dev = "false";
        polling_ms = <0>;
        gov_name = "performance";
        use_reg = "false";
        use_reg_dummy = "false";
        reg_name = "vdd_mif";
        volt_info = <25000 1250000 0 1000000>;
        use_tmu = "false";
        use_cl_dvfs = "false";
        use_sw_clk = "false";
    };
```

## Documentation/devicetree/bindings/display/panel/samsung,s6e3ha3.yaml
```yaml
# SPDX-License-Identifier: (GPL-2.0-only OR BSD-2-Clause)
%YAML 1.2
---
$id: http://devicetree.org/schemas/display/panel/samsung,s6e3ha3.yaml#
$schema: http://devicetree.org/meta-schemas/core.yaml#

title: Samsung S6E3HA3 1440x2560 command-mode AMOLED panel

maintainers:
  - Inki Dae <inki.dae@samsung.com>

allOf:
  - $ref: panel-common.yaml#

properties:
  compatible:
    const: samsung,s6e3ha3

  reg:
    maxItems: 1

  vdd3-supply:
    description: 3.0V DDI supply

  vci-supply:
    description: 1.8V DDI supply

  reset-gpios: true
  enable-gpios: true
  port: true

required:
  - compatible
  - reg
  - vdd3-supply
  - vci-supply
  - reset-gpios

additionalProperties: false

examples:
  - |
    #include <dt-bindings/gpio/gpio.h>

    dsi {
        #address-cells = <1>;
        #size-cells = <0>;

        panel@0 {
            compatible = "samsung,s6e3ha3";
            reg = <0>;
            vdd3-supply = <&ldo3>;
            vci-supply = <&ldo1>;
            reset-gpios = <&gpi2 0 GPIO_ACTIVE_LOW>;
            enable-gpios = <&gpd0 4 GPIO_ACTIVE_HIGH>;

            port {
                panel_in_dsim: endpoint {
                    remote-endpoint = <&dsim_out_panel>;
                };
            };
        };
    };
```

## Documentation/devicetree/bindings/display/samsung/samsung,exynos8890-decon.yaml
```yaml
# SPDX-License-Identifier: (GPL-2.0-only OR BSD-2-Clause)
%YAML 1.2
---
$id: http://devicetree.org/schemas/display/samsung/samsung,exynos8890-decon.yaml#
$schema: http://devicetree.org/meta-schemas/core.yaml#

title: Samsung Exynos8890 DECON-F display controller

maintainers:
  - Inki Dae <inki.dae@samsung.com>
  - Seung-Woo Kim <sw0312.kim@samsung.com>

description: |
  DECON-F drives the internal panel on the DISP0 domain. It blends up to
  eight windows but owns no DMA of its own: every window sources from one of
  the VPP IDMA channels described by samsung,exynos8890-vpp, selected through
  WIN_CONTROL.CHMAP.

properties:
  compatible:
    const: samsung,exynos8890-decon-f

  reg:
    maxItems: 1

  interrupts:
    maxItems: 4

  interrupt-names:
    items:
      - const: fifo
      - const: vstatus
      - const: framedone
      - const: rsc_conflict

  clocks:
    maxItems: 6

  clock-names:
    items:
      - const: disp_pll
      - const: decon_pclk
      - const: eclk_user
      - const: eclk_leaf
      - const: vclk_user
      - const: vclk_leaf

  power-domains:
    maxItems: 1

  samsung,vpp:
    $ref: /schemas/types.yaml#/definitions/phandle
    description:
      Phandle to the samsung,exynos8890-vpp node providing this DECON's
      window DMA channels.

  pinctrl-names:
    const: default

  pinctrl-0:
    description: TE input pin, muxed into DECON's hardware trigger.

  port:
    $ref: /schemas/graph.yaml#/properties/port
    description: Output to the MIPI-DSI host.

required:
  - compatible
  - reg
  - interrupts
  - interrupt-names
  - clocks
  - clock-names
  - power-domains
  - samsung,vpp
  - port

additionalProperties: false

examples:
  - |
    #include <dt-bindings/interrupt-controller/arm-gic.h>
    #include <dt-bindings/clock/samsung,exynos8890-cmu.h>

    display-controller@13960000 {
        compatible = "samsung,exynos8890-decon-f";
        reg = <0x13960000 0x10000>;
        interrupts = <GIC_SPI 180 IRQ_TYPE_LEVEL_HIGH>,
                     <GIC_SPI 181 IRQ_TYPE_LEVEL_HIGH>,
                     <GIC_SPI 182 IRQ_TYPE_LEVEL_HIGH>,
                     <GIC_SPI 183 IRQ_TYPE_LEVEL_HIGH>;
        interrupt-names = "fifo", "vstatus", "framedone", "rsc_conflict";
        clocks = <&cmu_disp0 CLK_FOUT_DISP_PLL>,
                 <&cmu_disp0 CLK_GOUT_DISP0_PCLK_DECON0>,
                 <&cmu_disp0 CLK_MOUT_DISP0_SCLK_DISP0_DECON0_ECLK0_USER>,
                 <&cmu_disp0 CLK_DOUT_DISP0_SCLK_DECON0_ECLK0>,
                 <&cmu_disp0 CLK_MOUT_DISP0_SCLK_DISP0_DECON0_VCLK0_USER>,
                 <&cmu_disp0 CLK_DOUT_DISP0_SCLK_DECON0_VCLK0>;
        clock-names = "disp_pll", "decon_pclk", "eclk_user", "eclk_leaf",
                      "vclk_user", "vclk_leaf";
        samsung,vpp = <&vpp>;
        power-domains = <&pd_disp0>;

        port {
            decon_out_dsim: endpoint {
                remote-endpoint = <&dsim_in_decon>;
            };
        };
    };
```

## Documentation/devicetree/bindings/display/samsung/samsung,exynos8890-dsim-observer.yaml
```yaml
# SPDX-License-Identifier: (GPL-2.0-only OR BSD-2-Clause)
%YAML 1.2
---
$id: http://devicetree.org/schemas/display/samsung/samsung,exynos8890-dsim-observer.yaml#
$schema: http://devicetree.org/meta-schemas/core.yaml#

title: Samsung Exynos8890 MIPI DSIM state observer

maintainers:
  - Inki Dae <inki.dae@samsung.com>
  - Seung-Woo Kim <sw0312.kim@samsung.com>

description: |
  A read-only diagnostic client for the Exynos8890 MIPI DSIM register block.
  It reports bootloader-configured link, compression, command scheduler, PLL,
  PHY and TE state without taking ownership of clocks, interrupts, power,
  PHYs, regulators, GPIOs, the MIPI host or panel hardware.

properties:
  compatible:
    const: samsung,exynos8890-dsim-observer

  reg:
    maxItems: 1

required:
  - compatible
  - reg

additionalProperties: false

examples:
  - |
    dsi-observer@13900000 {
        compatible = "samsung,exynos8890-dsim-observer";
        reg = <0x13900000 0x100>;
    };
```
