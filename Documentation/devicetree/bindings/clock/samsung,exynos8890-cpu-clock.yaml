## Documentation/devicetree/bindings/mailbox/samsung,exynos8890-mbox.yaml
```yaml
# SPDX-License-Identifier: (GPL-2.0-only OR BSD-2-Clause)
%YAML 1.2
---
$id: http://devicetree.org/schemas/mailbox/samsung,exynos8890-mbox.yaml#
$schema: http://devicetree.org/meta-schemas/core.yaml#

title: Samsung Exynos8890 MCU IPC mailbox

maintainers:
  - Krzysztof Kozlowski <krzk@kernel.org>

description: |
  The MCU IPC block connects the application processor and communication
  processor with sixteen doorbells in each direction and 64 shared 32-bit
  ISSR words. Incoming doorbells occupy bits 16 through 31 of the receive
  status, clear and mask registers. Outgoing doorbells occupy bits 0 through
  15 of the transmit generation register. Channel numbers identify physical
  doorbell bits, rather than message payloads. The syscon interface provides
  access to the shared words at register offsets 0x80 through 0x17c.

properties:
  compatible:
    items:
      - const: samsung,exynos8890-mbox
      - const: syscon

  reg:
    maxItems: 1

  interrupts:
    maxItems: 1
    description: Combined incoming-doorbell interrupt.

  '#mbox-cells':
    const: 1
    description: Doorbell channel number, from 0 to 15.

required:
  - compatible
  - reg
  - interrupts
  - '#mbox-cells'

additionalProperties: false

examples:
  - |
    #include <dt-bindings/interrupt-controller/arm-gic.h>

    mailbox@10540000 {
        compatible = "samsung,exynos8890-mbox", "syscon";
        reg = <0x10540000 0x180>;
        interrupts = <GIC_SPI 338 IRQ_TYPE_LEVEL_HIGH>;
        #mbox-cells = <1>;
    };
```

## Documentation/devicetree/bindings/mailbox/samsung,exynos8890-modem-mailbox.yaml
```yaml
# SPDX-License-Identifier: (GPL-2.0-only OR BSD-2-Clause)
%YAML 1.2
---
$id: http://devicetree.org/schemas/mailbox/samsung,exynos8890-modem-mailbox.yaml#
$schema: http://devicetree.org/meta-schemas/core.yaml#

title: Samsung Exynos8890 modem mailbox client

maintainers:
  - Samsung SoC Team <linux-samsung-soc@vger.kernel.org>

description: |
  Compatibility client which connects the SS310 modem interface to all
  sixteen channels of the generic Exynos mailbox controller. Shared mailbox
  words are accessed through the controller syscon while doorbells and
  receive callbacks use the mailbox framework.

properties:
  compatible:
    const: samsung,exynos8890-modem-mailbox

  samsung,mbox-syscon:
    $ref: /schemas/types.yaml#/definitions/phandle
    description: Exynos8890 mailbox controller shared-register syscon.

  mboxes:
    minItems: 16
    maxItems: 16

required:
  - compatible
  - samsung,mbox-syscon
  - mboxes

additionalProperties: false
```

## Documentation/devicetree/bindings/memory-controllers/samsung,exynos8890-dmc.yaml
```yaml
# SPDX-License-Identifier: (GPL-2.0-only OR BSD-2-Clause)
%YAML 1.2
---
$id: http://devicetree.org/schemas/memory-controllers/samsung,exynos8890-dmc.yaml#
$schema: http://devicetree.org/meta-schemas/core.yaml#

title: Samsung Exynos8890 Dynamic Memory Controller

maintainers:
  - Ivaylo Ivanov <ivo.ivanov.ivanov1@gmail.com>

description: |
  The Exynos8890 MIF frequency transaction spans four SMC/DREX channels,
  four LPDDR4 PHYs, the shared MIF PLL, CCORE clocks and PSCDC.  This node is
  the sole functional owner of those fields and of the vdd_mif rail while a
  frequency transition is in progress.

properties:
  compatible:
    const: samsung,exynos8890-dmc

  reg:
    minItems: 20
    maxItems: 20

  reg-names:
    items:
      - const: dmc-misc-ccore
      - const: cmu-top
      - const: cmu-ccore
      - const: pmu-alive
      - const: cmu-mif0
      - const: cmu-mif1
      - const: cmu-mif2
      - const: cmu-mif3
      - const: smc0
      - const: smc1
      - const: smc2
      - const: smc3
      - const: phy0
      - const: phy1
      - const: phy2
      - const: phy3
      - const: dmc-misc0
      - const: dmc-misc1
      - const: dmc-misc2
      - const: dmc-misc3

  clocks:
    minItems: 3
    maxItems: 3

  clock-names:
    items:
      - const: bus0-pll
      - const: bus3-pll
      - const: switch-gate

  vdd-supply:
    description: |
      S2MPS16 Buck1 regulator for the vdd_mif memory-interface rail. The DMC
      transaction uses the regulator driver's typed VTH-offset operation at
      the characterized 1.539 GHz crossing.

  samsung,apm:
    $ref: /schemas/types.yaml#/definitions/phandle
    description: APM ownership provider which holds firmware DVFS off.

required:
  - compatible
  - reg
  - reg-names
  - clocks
  - clock-names
  - vdd-supply
  - samsung,apm

additionalProperties: false

examples:
  - |
    memory-controller@10520000 {
        compatible = "samsung,exynos8890-dmc";
        reg = <0x10520000 0x10000>, <0x10570000 0x8000>,
              <0x105b0000 0x8000>, <0x105c0000 0x10000>,
              <0x10850000 0x8000>, <0x10950000 0x8000>,
              <0x10a50000 0x8000>, <0x10b50000 0x8000>,
              <0x10800000 0x10000>, <0x10900000 0x10000>,
              <0x10a00000 0x10000>, <0x10b00000 0x10000>,
              <0x10820000 0x10000>, <0x10920000 0x10000>,
              <0x10a20000 0x10000>, <0x10b20000 0x10000>,
              <0x10890000 0x1000>, <0x10990000 0x1000>,
              <0x10a90000 0x1000>, <0x10b90000 0x1000>;
        reg-names = "dmc-misc-ccore", "cmu-top", "cmu-ccore",
                    "pmu-alive", "cmu-mif0", "cmu-mif1", "cmu-mif2",
                    "cmu-mif3", "smc0", "smc1", "smc2", "smc3",
                    "phy0", "phy1", "phy2", "phy3", "dmc-misc0",
                    "dmc-misc1", "dmc-misc2", "dmc-misc3";
        clocks = <&cmu_top 215>, <&cmu_top 218>, <&cmu_top 402>;
        clock-names = "bus0-pll", "bus3-pll", "switch-gate";
        samsung,apm = <&apm>;
        vdd-supply = <&buck1>;
    };
```

## Documentation/devicetree/bindings/mfd/samsung,s2mpb02.yaml
```yaml
# SPDX-License-Identifier: (GPL-2.0-only OR BSD-2-Clause)
%YAML 1.2
---
$id: http://devicetree.org/schemas/mfd/samsung,s2mpb02.yaml#
$schema: http://devicetree.org/meta-schemas/core.yaml#

title: Samsung S2MPB02 camera and peripheral power-management IC

maintainers:
  - Krzysztof Kozlowski <krzk@kernel.org>

description: |
  The S2MPB02 is an I2C power-management IC containing two buck
  regulators, one buck-boost regulator, eighteen LDO regulators and
  flash LED control circuitry.

properties:
  compatible:
    const: samsung,s2mpb02

  reg:
    maxItems: 1

  interrupts:
    maxItems: 1

  wakeup-source: true

  regulators:
    type: object
    additionalProperties: false

    patternProperties:
      "^s2mpb02-(ldo([1-9]|1[0-8])|buck[12]|bb)$":
        $ref: /schemas/regulator/regulator.yaml#

required:
  - compatible
  - reg
  - regulators

additionalProperties: false

examples:
  - |
    i2c {
        #address-cells = <1>;
        #size-cells = <0>;

        pmic@59 {
            compatible = "samsung,s2mpb02";
            reg = <0x59>;

            regulators {
                s2mpb02-buck1 {
                    regulator-name = "VDD_1P3_EXT";
                    regulator-min-microvolt = <1300000>;
                    regulator-max-microvolt = <1300000>;
                    regulator-always-on;
                };

                s2mpb02-ldo18 {
                    regulator-name = "vmmc";
                    regulator-min-microvolt = <2800000>;
                    regulator-max-microvolt = <2800000>;
                };
            };
        };
    };
```

## Documentation/devicetree/bindings/misc/samsung,exynos8890-cbd-compat.yaml
```yaml
# SPDX-License-Identifier: (GPL-2.0-only OR BSD-2-Clause)
%YAML 1.2
---
$id: http://devicetree.org/schemas/misc/samsung,exynos8890-cbd-compat.yaml#
$schema: http://devicetree.org/meta-schemas/core.yaml#

title: Samsung Exynos8890 cbd compatibility interface

maintainers:
  - Krzysztof Kozlowski <krzk@kernel.org>

description: |
  Legacy userspace compatibility interface for Samsung cbd. The node contains
  no hardware resources; it references the SS310AP control and SIPC transport
  devices and exposes the established device names and ioctl ABI.

properties:
  compatible:
    const: samsung,exynos8890-cbd-compat

  samsung,cpctl:
    $ref: /schemas/types.yaml#/definitions/phandle

  samsung,sipc:
    $ref: /schemas/types.yaml#/definitions/phandle

required:
  - compatible
  - samsung,cpctl
  - samsung,sipc

additionalProperties: false

examples:
  - |
    cbd {
        compatible = "samsung,exynos8890-cbd-compat";
        samsung,cpctl = <&modem_control>;
        samsung,sipc = <&modem_sipc>;
    };
```

## Documentation/devicetree/bindings/net/samsung,exynos8890-sipc5.yaml
```yaml
# SPDX-License-Identifier: (GPL-2.0-only OR BSD-2-Clause)
%YAML 1.2
---
$id: http://devicetree.org/schemas/net/samsung,exynos8890-sipc5.yaml#
$schema: http://devicetree.org/meta-schemas/core.yaml#

title: Samsung Exynos8890 SIPC5 and SBD modem transport

maintainers:
  - Krzysztof Kozlowski <krzk@kernel.org>

description: |
  Shared-memory SIPC5 transport between the Exynos8890 application processor
  and SS310AP modem. Child nodes describe the externally visible SIPC channels
  and their SBD ring geometry.

properties:
  compatible:
    const: samsung,exynos8890-sipc5

  '#address-cells':
    const: 1

  '#size-cells':
    const: 0

  samsung,cpctl:
    $ref: /schemas/types.yaml#/definitions/phandle

  memory-region:
    maxItems: 1

  samsung,ipc-offset:
    $ref: /schemas/types.yaml#/definitions/uint32
    const: 0x08000000

  samsung,ipc-size:
    $ref: /schemas/types.yaml#/definitions/uint32
    const: 0x00800000

patternProperties:
  '^channel@[0-9a-f]+$':
    type: object
    additionalProperties: false
    properties:
      reg:
        maxItems: 1
        minimum: 0
        maximum: 255
      label: true
      samsung,format:
        enum: [formatted, raw, rfs, multi-raw, boot, dump, command, debug]
      samsung,type:
        enum: [misc, net, dummy]
      samsung,application:
        $ref: /schemas/types.yaml#/definitions/string
      samsung,option-region:
        $ref: /schemas/types.yaml#/definitions/string
      samsung,sipc5:
        type: boolean
      samsung,sbd:
        type: boolean
      samsung,no-link-header:
        type: boolean
      samsung,no-rx-limit:
        type: boolean
      samsung,tx-entries:
        $ref: /schemas/types.yaml#/definitions/uint32
      samsung,tx-buffer-size:
        $ref: /schemas/types.yaml#/definitions/uint32
      samsung,rx-entries:
        $ref: /schemas/types.yaml#/definitions/uint32
      samsung,rx-buffer-size:
        $ref: /schemas/types.yaml#/definitions/uint32
    required:
      - reg
      - label
      - samsung,format
      - samsung,type

required:
  - compatible
  - '#address-cells'
  - '#size-cells'
  - samsung,cpctl
  - memory-region
  - samsung,ipc-offset
  - samsung,ipc-size

additionalProperties: false

examples:
  - |
    sipc {
        compatible = "samsung,exynos8890-sipc5";
        #address-cells = <1>;
        #size-cells = <0>;
        samsung,cpctl = <&modem_control>;
        memory-region = <&modem_mem>;
        samsung,ipc-offset = <0x08000000>;
        samsung,ipc-size = <0x00800000>;

        channel@eb {
            reg = <235>;
            label = "umts_ipc0";
            samsung,format = "formatted";
            samsung,type = "misc";
            samsung,application = "RIL";
            samsung,sipc5;
            samsung,sbd;
            samsung,tx-entries = <16>;
            samsung,tx-buffer-size = <4096>;
            samsung,rx-entries = <32>;
            samsung,rx-buffer-size = <4096>;
        };
    };
```

## Documentation/devicetree/bindings/power/samsung,exynos8890-cpuidle-test.yaml
```yaml
# SPDX-License-Identifier: (GPL-2.0-only OR BSD-2-Clause)
%YAML 1.2
---
$id: http://devicetree.org/schemas/power/samsung,exynos8890-cpuidle-test.yaml#
$schema: http://devicetree.org/meta-schemas/core.yaml#

title: Samsung Exynos8890 opt-in local-core C2 diagnostics

maintainers:
  - Krzysztof Kozlowski <krzk@kernel.org>

description: |
  Diagnostic-only controller for validating affinity-level-0 CPU power-down on
  Exynos8890. The driver is disabled unless selected in Kconfig, enabled in the
  device tree, opted in on the kernel command line, and enabled per CPU through
  cpuidle sysfs. Both clusters support local C2. When every online CPU in the
  non-boot cluster is eligible, the driver may also request cluster power-down.
  Boot-cluster and system power-down are not supported.

properties:
  compatible:
    const: samsung,exynos8890-cpuidle-test

  samsung,psci-suspend-param:
    $ref: /schemas/types.yaml#/definitions/uint32
    const: 0x00010000
    description: PSCI original-format affinity-level-0 power-down state.

  samsung,cpd-residency-us:
    $ref: /schemas/types.yaml#/definitions/uint32
    minimum: 1
    default: 3000
    description:
      Minimum promised idle duration for every online non-boot-cluster CPU
      before cluster power-down may be requested.

required:
  - compatible
  - samsung,psci-suspend-param

additionalProperties: false

examples:
  - |
    cpuidle-test {
        compatible = "samsung,exynos8890-cpuidle-test";
        samsung,psci-suspend-param = <0x00010000>;
        status = "disabled";
    };
```
