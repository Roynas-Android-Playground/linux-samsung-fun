## Documentation/devicetree/bindings/display/samsung/samsung,exynos8890-vpp-observer.yaml
```yaml
# SPDX-License-Identifier: (GPL-2.0-only OR BSD-2-Clause)
%YAML 1.2
---
$id: http://devicetree.org/schemas/display/samsung/samsung,exynos8890-vpp-observer.yaml#
$schema: http://devicetree.org/meta-schemas/core.yaml#

title: Samsung Exynos8890 VPP state observer

maintainers:
  - Inki Dae <inki.dae@samsung.com>
  - Seung-Woo Kim <sw0312.kim@samsung.com>

description: |
  A read-only diagnostic client for an Exynos8890 VPP/IDMA register block.
  It reports the bootloader-configured source format, geometry, DMA address,
  ping-pong and real-time path state without taking ownership of clocks,
  interrupts, power domains, IOMMUs or framebuffer memory.

properties:
  compatible:
    const: samsung,exynos8890-vpp-observer

  reg:
    maxItems: 1

required:
  - compatible
  - reg

additionalProperties: false

examples:
  - |
    vpp-observer@13952000 {
        compatible = "samsung,exynos8890-vpp-observer";
        reg = <0x13952000 0x1000>;
    };
```

## Documentation/devicetree/bindings/display/samsung/samsung,exynos8890-vpp.yaml
```yaml
# SPDX-License-Identifier: (GPL-2.0-only OR BSD-2-Clause)
%YAML 1.2
---
$id: http://devicetree.org/schemas/display/samsung/samsung,exynos8890-vpp.yaml#
$schema: http://devicetree.org/meta-schemas/core.yaml#

title: Samsung Exynos8890 VPP window DMA

maintainers:
  - Inki Dae <inki.dae@samsung.com>
  - Seung-Woo Kim <sw0312.kim@samsung.com>

description: |
  The four IDMA channels (G0, G1, VG0 and VG1) that feed DECON-F's blending
  windows on the DISP0 domain. They are described by a single node because
  they share two ACLK gates, one power domain and a SysMMU pair - a device
  per channel would place two masters in each IOMMU group, which
  iommu_attach_device() rejects.

properties:
  compatible:
    const: samsung,exynos8890-vpp

  reg:
    maxItems: 4

  reg-names:
    items:
      - const: vpp-g0
      - const: vpp-g1
      - const: vpp-vg0
      - const: vpp-vg1

  interrupts:
    maxItems: 4

  interrupt-names:
    items:
      - const: vpp0
      - const: vpp1
      - const: vpp2
      - const: vpp3

  clocks:
    maxItems: 2

  clock-names:
    items:
      - const: aclk_vpp0
      - const: aclk_vpp1

  power-domains:
    maxItems: 1

  iommus:
    maxItems: 2

  memory-region:
    maxItems: 1
    description:
      Reserved region still being scanned out at hand-off, so that
      of_iommu_get_resv_regions() direct-maps it before a domain is
      installed under the running DMA.

required:
  - compatible
  - reg
  - reg-names
  - interrupts
  - clocks
  - clock-names
  - power-domains
  - iommus

additionalProperties: false

examples:
  - |
    #include <dt-bindings/interrupt-controller/arm-gic.h>
    #include <dt-bindings/clock/samsung,exynos8890-cmu.h>

    vpp@13951000 {
        compatible = "samsung,exynos8890-vpp";
        reg = <0x13951000 0x1000>,
              <0x13952000 0x1000>,
              <0x13953000 0x1000>,
              <0x13954000 0x1000>;
        reg-names = "vpp-g0", "vpp-g1", "vpp-vg0", "vpp-vg1";
        interrupts = <GIC_SPI 176 IRQ_TYPE_LEVEL_HIGH>,
                     <GIC_SPI 177 IRQ_TYPE_LEVEL_HIGH>,
                     <GIC_SPI 178 IRQ_TYPE_LEVEL_HIGH>,
                     <GIC_SPI 179 IRQ_TYPE_LEVEL_HIGH>;
        interrupt-names = "vpp0", "vpp1", "vpp2", "vpp3";
        clocks = <&cmu_disp0 CLK_GOUT_DISP0_ACLK_VPP0_ACLK_0>,
                 <&cmu_disp0 CLK_GOUT_DISP0_ACLK_VPP0_ACLK_1>;
        clock-names = "aclk_vpp0", "aclk_vpp1";
        power-domains = <&pd_disp0>;
        iommus = <&sysmmu_disp0_00>, <&sysmmu_disp0_01>;
    };
```

## Documentation/devicetree/bindings/extcon/maxim,max77843.yaml
```yaml
# SPDX-License-Identifier: GPL-2.0-only OR BSD-2-Clause
%YAML 1.2
---
$id: http://devicetree.org/schemas/extcon/maxim,max77843.yaml#
$schema: http://devicetree.org/meta-schemas/core.yaml#

title: Maxim MAX77843 MicroUSB and Companion Power Management IC Extcon

maintainers:
  - Chanwoo Choi <cw00.choi@samsung.com>
  - Krzysztof Kozlowski <krzk@kernel.org>

description: |
  This is a part of device tree bindings for Maxim MAX77843 MicroUSB
  Integrated Circuit (MUIC).

  See also Documentation/devicetree/bindings/mfd/maxim,max77843.yaml for
  additional information and example.

properties:
  compatible:
    const: maxim,max77843-muic

  connector:
    $ref: /schemas/connector/usb-connector.yaml#
    unevaluatedProperties: false

  maxim,afc-request-byte:
    $ref: /schemas/types.yaml#/definitions/uint8
    default: 0x46
    description: |
      The capability the MUIC asks an Adaptive Fast Charging charger for.
      Bits 7-4 select the voltage as 5V plus one volt per step, bits 3-0 the
      current as 0.75A plus 0.15A per step, so the default 0x46 requests
      9V at 1.65A. Chargers that cannot meet the request negotiate downwards.

  ports:
    $ref: /schemas/graph.yaml#/properties/ports
    description:
      Any connector to the data bus of this controller should be modelled using
      the OF graph bindings specified
    properties:
      port:
        $ref: /schemas/graph.yaml#/properties/port

required:
  - compatible
  - connector

additionalProperties: false
```

## Documentation/devicetree/bindings/firmware/samsung,exynos8890-ect.yaml
```yaml
# SPDX-License-Identifier: (GPL-2.0-only OR BSD-2-Clause)
%YAML 1.2
---
$id: http://devicetree.org/schemas/firmware/samsung,exynos8890-ect.yaml#
$schema: http://devicetree.org/meta-schemas/core.yaml#

title: Samsung Exynos8890 Embedded Configuration Table

maintainers:
  - Krzysztof Kozlowski <krzk@kernel.org>

description: |
  S-Boot places an Embedded Configuration Table in reserved DRAM. It contains
  characterized DVFS clock rows and per-table-version ASV voltage data. Secure
  per-die fuse words are read through the Exynos legacy register-read SMC.

properties:
  compatible:
    const: samsung,exynos8890-ect

  memory-region:
    maxItems: 1

  method:
    const: smc

required:
  - compatible
  - memory-region
  - method

additionalProperties: false

examples:
  - |
    firmware {
        ect {
            compatible = "samsung,exynos8890-ect";
            memory-region = <&ect_reserved>;
            method = "smc";
        };
    };
```

## Documentation/devicetree/bindings/gnss/brcm,bcm4773.yaml
```yaml
# SPDX-License-Identifier: (GPL-2.0-only OR BSD-2-Clause)
%YAML 1.2
---
$id: http://devicetree.org/schemas/gnss/brcm,bcm4773.yaml#
$schema: http://devicetree.org/meta-schemas/core.yaml#

title: Broadcom BCM4773 GNSS and sensor-hub device

maintainers:
  - Johan Hovold <johan@kernel.org>

description: |
  The BCM4773 combines a GNSS receiver and sensor hub behind Broadcom's SSI
  protocol transported over SPI. GPIO handshake lines coordinate transfers
  between the application processor and BCM4773.

allOf:
  - $ref: gnss-common.yaml#
  - $ref: /schemas/spi/spi-peripheral-props.yaml#

properties:
  compatible:
    const: brcm,bcm4773

  reg:
    maxItems: 1

  spi-max-frequency:
    maximum: 26000000

  host-request-gpios:
    maxItems: 1
    description:
      BCM4773 HOST_REQ output. An asserted line tells the application processor
      that data is pending and is also used as the transport interrupt.

  mcu-request-gpios:
    maxItems: 1
    description:
      Application-processor request output used to wake BCM4773 before an SSI
      transaction.

  mcu-response-gpios:
    maxItems: 1
    description:
      BCM4773 response output indicating that the device is awake and ready for
      an SSI transaction.

required:
  - compatible
  - reg
  - spi-max-frequency
  - enable-gpios
  - host-request-gpios
  - mcu-request-gpios
  - mcu-response-gpios

unevaluatedProperties: false

examples:
  - |
    #include <dt-bindings/gpio/gpio.h>

    spi {
        #address-cells = <1>;
        #size-cells = <0>;

        gnss@0 {
            compatible = "brcm,bcm4773";
            reg = <0>;
            spi-max-frequency = <26000000>;
            spi-cpol;
            spi-cpha;

            enable-gpios = <&gpio0 1 GPIO_ACTIVE_HIGH>;
            host-request-gpios = <&gpio0 2 GPIO_ACTIVE_HIGH>;
            mcu-request-gpios = <&gpio0 3 GPIO_ACTIVE_HIGH>;
            mcu-response-gpios = <&gpio0 4 GPIO_ACTIVE_HIGH>;
        };
    };
```

## Documentation/devicetree/bindings/iio/common/samsung,exynos8890-ssp.yaml
```yaml
# SPDX-License-Identifier: (GPL-2.0-only OR BSD-2-Clause)
%YAML 1.2
---
$id: http://devicetree.org/schemas/iio/common/samsung,exynos8890-ssp.yaml#
$schema: http://devicetree.org/meta-schemas/core.yaml#

title: Samsung Exynos8890 SSP sensor-hub protocol core

maintainers:
  - Krzysztof Kozlowski <krzk@kernel.org>

description: |
  Samsung "SSP" application-layer protocol core for the sensor-hub MCU
  reachable through a BCM4773 GNSS/sensor SPI transport (see
  Documentation/devicetree/bindings/gnss/brcm,bcm4773.yaml, where present,
  for the transport node itself). The node owns no hardware resources of
  its own; it references the BCM4773 transport node and exchanges RPC
  records with it.

properties:
  compatible:
    const: samsung,exynos8890-ssp

  samsung,transport:
    $ref: /schemas/types.yaml#/definitions/phandle
    description: Phandle to the BCM4773 SPI device providing the shared
      GNSS/sensor RPC transport.

required:
  - compatible
  - samsung,transport

additionalProperties: false

examples:
  - |
    sensorhub {
        compatible = "samsung,exynos8890-ssp";
        samsung,transport = <&gnss0>;
    };
```

## Documentation/devicetree/bindings/input/maxim,max86900.yaml
```yaml
# SPDX-License-Identifier: (GPL-2.0-only OR BSD-2-Clause)
%YAML 1.2
---
$id: http://devicetree.org/schemas/input/maxim,max86900.yaml#
$schema: http://devicetree.org/meta-schemas/core.yaml#

title: Maxim MAX86900 and MAX86907 optical heart-rate sensors

maintainers:
  - Royna2544 <whiteshell2544@naver.com>

description: |
  Optical pulse sensors with an I2C interface and active-low interrupt.
  MAX86907 uses the MAX86902 register map and must not fall back to the
  incompatible MAX86900 compatible. The board identifies the populated
  variant; ordinary part/revision registers cannot distinguish all OTP
  subvariants of the MAX86902 family.

properties:
  compatible:
    enum:
      - maxim,max86900
      - maxim,max86907

  reg:
    maxItems: 1

  interrupts:
    maxItems: 1

  vdd-supply:
    description: Digital and analog supply (1.8 V for MAX86907).

  led-supply:
    description: LED supply (3.3 V for MAX86907).

required:
  - compatible
  - reg
  - interrupts
  - vdd-supply
  - led-supply

allOf:
  - if:
      properties:
        compatible:
          const: maxim,max86907
    then:
      properties:
        reg:
          items:
            - const: 0x57
    else:
      properties:
        reg:
          items:
            - const: 0x51

additionalProperties: false

examples:
  - |
    #include <dt-bindings/interrupt-controller/irq.h>

    i2c {
        #address-cells = <1>;
        #size-cells = <0>;

        heart-rate@57 {
            compatible = "maxim,max86907";
            reg = <0x57>;
            interrupt-parent = <&gpa2>;
            interrupts = <0 IRQ_TYPE_EDGE_FALLING>;
            vdd-supply = <&hrm_1p8>;
            led-supply = <&hrm_3p3>;
        };
    };
```

## Documentation/devicetree/bindings/iommu/samsung,exynos8890-sysmmu-observer.yaml
```yaml
# SPDX-License-Identifier: (GPL-2.0-only OR BSD-2-Clause)
%YAML 1.2
---
$id: http://devicetree.org/schemas/iommu/samsung,exynos8890-sysmmu-observer.yaml#
$schema: http://devicetree.org/meta-schemas/core.yaml#

title: Samsung Exynos8890 System MMU state observer

maintainers:
  - Marek Szyprowski <m.szyprowski@samsung.com>

description: |
  A read-only diagnostic client for an Exynos8890 System MMU register block.
  It reports the bootloader-configured translation context and fault state
  without taking ownership of clocks, interrupts, power domains, IOMMU
  domains, page tables or client devices.

properties:
  compatible:
    const: samsung,exynos8890-sysmmu-observer

  reg:
    maxItems: 1

required:
  - compatible
  - reg

additionalProperties: false

examples:
  - |
    iommu-observer@13a10000 {
        compatible = "samsung,exynos8890-sysmmu-observer";
        reg = <0x13a10000 0x1000>;
    };
```

## Documentation/devicetree/bindings/leds/maxim,max77854.yaml
```yaml
# SPDX-License-Identifier: (GPL-2.0-only OR BSD-2-Clause)
%YAML 1.2
---
$id: http://devicetree.org/schemas/leds/maxim,max77854.yaml#
$schema: http://devicetree.org/meta-schemas/core.yaml#

title: Maxim MAX77854 notification LEDs

maintainers:
  - Krzysztof Kozlowski <krzk@kernel.org>

description: |
  The MAX77854 companion PMIC contains four current-controlled LED outputs.
  Channel zero is a board service output on Samsung herolte. Channels one to
  three drive the red, green and blue notification LED dies.

properties:

  "#address-cells":
    const: 1

  "#size-cells":
    const: 0

  compatible:
    const: maxim,max77854-led

  led@1:
    type: object
    $ref: common.yaml#
    unevaluatedProperties: false
    properties:
      reg:
        const: 1
      color:
        const: 1
      function:
        const: status
      status:
        const: okay
      max-brightness:
        minimum: 1
        maximum: 2
      retain-state-shutdown: false
    required: [reg, color, function]

  led@2:
    type: object
    $ref: common.yaml#
    unevaluatedProperties: false
    properties:
      reg:
        const: 2
      color:
        const: 2
      function:
        const: status
      status:
        const: okay
      max-brightness:
        minimum: 1
        maximum: 2
      retain-state-shutdown: false
    required: [reg, color, function]

  led@3:
    type: object
    $ref: common.yaml#
    unevaluatedProperties: false
    properties:
      reg:
        const: 3
      color:
        const: 3
      function:
        const: status
      status:
        const: okay
      max-brightness:
        minimum: 1
        maximum: 2
      retain-state-shutdown: false
    required:
      - reg
      - color
      - function

required:
  - "#address-cells"
  - "#size-cells"
  - compatible
  - led@1
  - led@2
  - led@3

additionalProperties: false

examples:
  - |
    #include <dt-bindings/leds/common.h>

    leds {
        compatible = "maxim,max77854-led";
        #address-cells = <1>;
        #size-cells = <0>;

        led@1 {
            reg = <1>;
            color = <LED_COLOR_ID_RED>;
            function = LED_FUNCTION_STATUS;
        };

        led@2 {
            reg = <2>;
            color = <LED_COLOR_ID_GREEN>;
            function = LED_FUNCTION_STATUS;
        };

        led@3 {
            reg = <3>;
            color = <LED_COLOR_ID_BLUE>;
            function = LED_FUNCTION_STATUS;
        };
    };
```

## Documentation/devicetree/bindings/leds/samsung,s2mpb02-torch.yaml
```yaml
# SPDX-License-Identifier: (GPL-2.0-only OR BSD-2-Clause)
%YAML 1.2
---
$id: http://devicetree.org/schemas/leds/samsung,s2mpb02-torch.yaml#
$schema: http://devicetree.org/meta-schemas/core.yaml#

title: Samsung S2MPB02 torch LED

maintainers:
  - Krzysztof Kozlowski <krzk@kernel.org>

description: |
  Low-current continuous torch operation of the primary S2MPB02 flash output.
  Flash strobe and the secondary output are outside this binding.

properties:
  compatible:
    const: samsung,s2mpb02-torch

  max-current-microamp:
    enum: [20000, 40000, 60000, 80000, 100000]
    description: Maximum continuous torch current exposed to userspace.

  torch-enable-gpios:
    maxItems: 1
    description: External active-high torch input held low during I2C control.

required:
  - compatible
  - max-current-microamp
  - torch-enable-gpios

additionalProperties: false
```
