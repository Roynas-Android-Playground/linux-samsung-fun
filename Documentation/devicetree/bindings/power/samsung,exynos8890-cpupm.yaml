## drivers/media/dvb-frontends/fc8080/Kconfig
```kconfig
# SPDX-License-Identifier: GPL-2.0

config DVB_FC8080
	tristate "FCI FC8080 T-DMB tuner + demodulator"
	depends on DVB_CORE
	default m if !MEDIA_SUBDRV_AUTOSELECT
	help
	  Say Y when you want to support this frontend. The chip is a
	  T-DMB/DAB tuner and baseband found on Korean Galaxy S7 variants.
```

## drivers/media/platform/samsung/exynos-mdev/Kconfig
```kconfig
# SPDX-License-Identifier: GPL-2.0-only

config VIDEO_EXYNOS_MDEV
	tristate "Exynos media device driver"
	depends on ARCH_EXYNOS || COMPILE_TEST
	select MEDIA_CONTROLLER
	select VIDEO_DEV
	help
	  Registers the shared v4l2_device/media_device that Exynos VPP and
	  DECON subdevs attach their media-controller links to
	  (decon8890 looks this driver up by name at probe with no
	  deferred-probe fallback, so it must be built in/loaded first).
```

## drivers/media/tdmb/Kconfig
```kconfig
#
# T-DMB tuner driver configuration
#

config TDMB
	tristate "T-DMB tuner driver support"
	help
	  Say Y here to enable the T-DMB tuner driver.
	  This driver supports the Samsung Exynos8890 Herolte platform
	  with the FC8080 tuner via SPI.

	  To compile this driver as a module, choose M here: the module
	  will be called tdmb.

config TDMB_FC8080
	bool "FC8080 tuner"
	depends on TDMB
	select DVB_FC8080
	help
	  Select this if your tuner is an FC8080.

config TDMB_SPI
	bool "T-DMB over SPI"
	depends on TDMB && SPI_MASTER
	help
	  Select this if the tuner's host interface is SPI. This is the
	  only transport wired up on herolte; without it the driver has no
	  way to reach the chip's registers.

config TDMB_XTAL_FREQ
	bool "T-DMB crystal frequency from device tree"
	depends on TDMB
	default y
	help
	  Take the tuner's reference crystal frequency from the
	  tdmb_xtal_freq device tree property instead of the driver's
	  24.576MHz default. herolte fits a 24.000MHz part, and the FC8080
	  tuner PLL is programmed straight from this value.

config TDMB_DEBUG
	bool "T-DMB debug prints"
	depends on TDMB
	default n
	help
	  Enable debug prints for the T-DMB driver.

config TDMB_ANT_DET
	bool "T-DMB antenna detection"
	depends on TDMB
	help
	  Enable antenna detection via GPIO input event.

config TDMB_VREG_SUPPORT
	bool "T-DMB regulator support"
	depends on TDMB
	help
	  Enable regulator support for the T-DMB tuner power supply.
```

## drivers/memory/samsung/Kconfig
```kconfig
# SPDX-License-Identifier: GPL-2.0
config SAMSUNG_MC
	bool "Samsung Exynos Memory Controller support"
	depends on ARCH_EXYNOS || COMPILE_TEST
	help
	  Support for the Memory Controller (MC) devices found on
	  Samsung Exynos SoCs.

if SAMSUNG_MC

config EXYNOS5422_DMC
	tristate "Exynos5422 Dynamic Memory Controller driver"
	depends on ARCH_EXYNOS || (COMPILE_TEST && HAS_IOMEM)
	select DDR
	depends on DEVFREQ_GOV_SIMPLE_ONDEMAND
	depends on (PM_DEVFREQ && PM_DEVFREQ_EVENT)
	help
	  This adds driver for Samsung Exynos5422 SoC DMC (Dynamic Memory
	  Controller).  The driver provides support for Dynamic Voltage and
	  Frequency Scaling in DMC and DRAM. It also supports changing timings
	  of DRAM running with different frequency. The timings are calculated
	  based on DT memory information.
	  If unsure, say Y on devices with Samsung Exynos SoCs.

config EXYNOS8890_DMC
	bool "Exynos8890 native MIF/DMC DVFS owner"
	depends on ARM64 && ARCH_EXYNOS
	depends on EXYNOS_ARM64_COMMON_CLK && REGULATOR
	depends on REGULATOR_S2MPS11=y
	depends on EXYNOS8890_APM=y
	depends on EXYNOS8890_CALIBRATION
	help
	  Build the native Exynos8890 LPDDR4 frequency-change owner.  The
	  driver performs the four-channel DREX/PHY timing, shared MIF PLL and
	  PSCDC transaction as one serialized operation and consumes immutable
	  calibration data rather than the writable PWRCAL DFS implementation.

config EXYNOS_SROM
	bool "Exynos SROM controller driver" if COMPILE_TEST
	depends on (ARM && ARCH_EXYNOS) || (COMPILE_TEST && HAS_IOMEM)
	help
	  This adds driver for Samsung Exynos SoC SROM controller.  The driver
	  in basic operation mode only saves and restores SROM registers
	  during suspend.  If however appropriate device tree configuration
	  is provided, the driver enables support for external memory
	  or external devices.
	  If unsure, say Y on devices with Samsung Exynos SoCs.

endif
```

## drivers/soc/samsung/Kconfig
```kconfig
# SPDX-License-Identifier: GPL-2.0
#
# Samsung SoC drivers
#
menuconfig SOC_SAMSUNG
	bool "Samsung SoC driver support" if COMPILE_TEST

if SOC_SAMSUNG

# There is no need to enable these drivers for ARMv8
config EXYNOS_ASV_ARM
	bool "Exynos ASV ARMv7-specific driver extensions" if COMPILE_TEST
	depends on EXYNOS_CHIPID

config EXYNOS_CHIPID
	tristate "Exynos ChipID controller and ASV driver"
	depends on ARCH_EXYNOS || COMPILE_TEST
	default ARCH_EXYNOS
	select EXYNOS_ASV_ARM if ARM && ARCH_EXYNOS
	select MFD_SYSCON
	select SOC_BUS
	help
	  Support for Samsung Exynos SoC ChipID and Adaptive Supply Voltage.
	  This driver can also be built as module (exynos_chipid).

config EXYNOS8890_ECT
	tristate "Exynos8890 ECT and adaptive voltage parser"
	depends on ARM64 && ARCH_EXYNOS
	select CRC32
	help
	  Parse the bootloader-provided Exynos8890 Embedded Configuration Table
	  and combine its characterized CPU voltage data with secure per-die ASV
	  fuse values. Validate the consumed table versions, groups, SSA
	  adjustments and CPU voltage ordering. The parser treats the reserved
	  memory blob itself as trusted bootloader input; it is not a boundary for
	  untrusted firmware data.
	
config EXYNOS8890_ECT_DUMP
	bool "Enable Exynos Characteristic Table File Dump sysfs"
	default n
	depends on EXYNOS8890_ECT

config EXYNOS8890_CALIBRATION
	bool "Exynos8890 read-only DVFS calibration data"
	depends on ARM64 && ARCH_EXYNOS && OF
	select EXYNOS8890_ECT
	help
	  Copy the bootloader ECT rate tables and secure per-die ASV fuse
	  selection into an immutable, unit-safe interface for native CCF, OPP,
	  CPU frequency and memory-controller drivers.  This provider never
	  writes CMU, PMU, DMC or DDR PHY registers and does not construct a
	  second clock topology.

config EXYNOS8890_CPUIDLE
	bool "Exynos8890 opt-in local-core C2 diagnostics"
	depends on ARM64 && ARCH_EXYNOS && CPU_IDLE && ARM_PSCI_FW
	depends on !ARM_PSCI_CPUIDLE
	depends on !PREEMPT_RT
	depends on EXYNOS8890_CPUPM
	select CPU_IDLE_MULTIPLE_DRIVERS
	help
	  Build a deliberately opt-in Exynos8890 local-core power-down driver.
	  It supports local C2 on both clusters and cluster power-down only on
	  the non-boot cluster. C2 starts disabled and requires both
	  exynos8890.c2=1 and explicit per-CPU sysfs enablement. System idle is
	  excluded. This is a hardware diagnostic and must not be enabled as
	  production policy.

config EXYNOS8890_CPUPM
	bool "Exynos8890 CPU/cluster PMU power-control ops"
	depends on ARM64 && ARCH_EXYNOS && OF
	select MFD_SYSCON
	default y
	help
	  Port of vendor Cronos_8890 exynos-pmu.c CPU power ops: PMU
	  CPU_CONFIG/CPU_STATUS local power gating, cluster CPUSEQ_OPTION
	  sequencer control (cluster_up = sequencer disabled), and
	  NONCPU/L2 cluster status queries. Also enforces the vendor
	  lifecycle invariant that the non-boot cluster's sequencer is
	  disabled on every CPU hotplug-in. Consumers: future C2/CPD idle
	  coordination and the cpufreq block_cpd()/release_cpd() exclusion.

config EXYNOS8890_PM
	bool "Exynos8890 PM coordination and mem-suspend"
	depends on ARM64 && ARCH_EXYNOS && OF && SUSPEND && ARM_PSCI_FW
	depends on EXYNOS_PMU
	select MFD_SYSCON
	help
	  Native PMU and PSCI system-sleep coordination for Exynos8890.  The
	  driver programs only PMU wakeup/sequencer policy and leaves all CMU
	  context ownership to the Samsung common clock framework.  Mem-suspend
	  remains blocked until native clock/domain owners can perform the vendor
	  TOP user-mux, Q-channel and cluster PWR_CTRL3 choreography.  It does not
	  use the vendor PWRCAL suspend path.

config EXYNOS8890_CPCTL
	tristate "Exynos8890 SS310AP control plane"
	depends on ARM64 && ARCH_EXYNOS && OF && MAILBOX
	depends on !SEC_SIPC_MODEM_IF
	select MFD_SYSCON
	help
	  Build the contract-preserving SS310AP control plane for Exynos8890.
	  This is mutually exclusive with the legacy Samsung modem_v1 stack.

config EXYNOS8890_APM
	bool "Exynos8890 APM DVFS ownership provider"
	depends on ARM64 && ARCH_EXYNOS && OF && EXYNOS_PMU
	select MFD_SYSCON
	help
	  Hold the Exynos8890 APM Cortex-M3 in PMU power-down so it can never
	  contest DVFS decisions, and hand exclusive ownership of CPU/bus
	  clock and voltage control to Linux before any native DVFS consumer
	  can probe. This does not load or speak to the vendor APM firmware.

config EXYNOS_USI
	tristate "Exynos USI (Universal Serial Interface) driver"
	default ARCH_EXYNOS && ARM64
	depends on ARCH_EXYNOS || COMPILE_TEST
	select MFD_SYSCON
	help
	  Enable support for USI block. USI (Universal Serial Interface) is an
	  IP-core found in modern Samsung Exynos SoCs, like Exynos850 and
	  ExynosAutoV9. USI block can be configured to provide one of the
	  following serial protocols: UART, SPI or High Speed I2C.

	  This driver allows one to configure USI for desired protocol, which
	  is usually done in USI node in Device Tree.

config EXYNOS_PMU
	bool "Exynos PMU controller driver" if COMPILE_TEST
	depends on ARCH_EXYNOS || ((ARM || ARM64) && COMPILE_TEST)
	select EXYNOS_PMU_ARM_DRIVERS if ARM && ARCH_EXYNOS
	select MFD_CORE
	select REGMAP_MMIO

# There is no need to enable these drivers for ARMv8
config EXYNOS_PMU_ARM_DRIVERS
	bool "Exynos PMU ARMv7-specific driver extensions" if COMPILE_TEST
	depends on EXYNOS_PMU

config SAMSUNG_PM_CHECK
	bool "S3C2410 PM Suspend Memory CRC"
	depends on PM && (ARCH_S3C64XX || ARCH_S5PV210)
	select CRC32
	help
	  Enable the PM code's memory area checksum over sleep. This option
	  will generate CRCs of all blocks of memory, and store them before
	  going to sleep. The blocks are then checked on resume for any
	  errors.

	  Note, this can take several seconds depending on memory size
	  and CPU speed.

config SAMSUNG_PM_CHECK_CHUNKSIZE
	int "S3C2410 PM Suspend CRC Chunksize (KiB)"
	depends on PM && SAMSUNG_PM_CHECK
	default 64
	help
	  Set the chunksize in Kilobytes of the CRC for checking memory
	  corruption over suspend and resume. A smaller value will mean that
	  the CRC data block will take more memory, but will identify any
	  faults with better precision.

config EXYNOS_REGULATOR_COUPLER
	bool "Exynos SoC Regulator Coupler" if COMPILE_TEST
	depends on ARCH_EXYNOS || COMPILE_TEST
endif
```

## drivers/video/fbdev/exynos/Kconfig
```kconfig
# SPDX-License-Identifier: GPL-2.0

config EXYNOS8890_DECON
	bool "Samsung Exynos8890 DECON/DSIM/VPP display driver"
	depends on FB && ARCH_EXYNOS
	select FB_CFB_FILLRECT
	select FB_CFB_COPYAREA
	select FB_CFB_IMAGEBLIT
	select MEDIA_SUPPORT
	select MEDIA_CONTROLLER
	select VIDEO_DEV
	select VIDEO_EXYNOS_MDEV
	select PHY_EXYNOS8890_MIPI
	select LCD_CLASS_DEVICE
	select EXYNOS8890_ECT
	select EXYNOS_VPP
	select PANEL_S6E3HA3_DYNAMIC
	help
	  Ported from vendor drivers/video/fbdev/exynos/decon_8890/: DECON
	  display controller, DSIM MIPI-DSI host, VPP window DMA, and the
	  S6E3HA3 dynamic-backlight panel driver used on herolte. This models
	  vendor's real init/mode-set sequencing rather than the read-only
	  "inherited state" takeover in drivers/gpu/drm/exynos/
	  exynos8890_drm_decon.c.

config PANEL_S6E3HA3_DYNAMIC
	bool "S6E3HA3 dynamic-AID-dimming AMOLED panel (herolte)"
	depends on EXYNOS8890_DECON
	select PANEL_AID_DIMMING
	help
	  The S6E3HA3 WQHD AMOLED panel driven over MIPI-DSI, as used on
	  herolte, with per-frame AID/ACL brightness dimming. Selects the
	  panels/s6e3ha3_s6e3ha2_wqhd_param.h command/gamma tables.

config PANEL_AID_DIMMING
	bool
	help
	  Per-gray-level AID (Analog and Digital Illumination) brightness
	  interpolation, used by AMOLED panels that don't do dimming in the
	  DDI itself.

config EXYNOS_VPP
	bool
	help
	  Creates the media-controller pad links between the VPP window-DMA
	  subdevs and DECON's sink pads in decon_create_links() - required
	  for the VPP<->DECON composition pipeline this port already relies
	  on throughout (vpp_drv.c, decon_core.c's v4l2_subdev_call() into
	  VPP_WIN_CONFIG etc.), not an optional feature.
```
