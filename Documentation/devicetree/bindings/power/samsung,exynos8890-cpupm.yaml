## Documentation/devicetree/bindings/power/samsung,exynos8890-cpupm.yaml
```yaml
# SPDX-License-Identifier: (GPL-2.0-only OR BSD-2-Clause)
%YAML 1.2
---
$id: http://devicetree.org/schemas/power/samsung,exynos8890-cpupm.yaml#
$schema: http://devicetree.org/meta-schemas/core.yaml#

title: Samsung Exynos8890 CPU power-management child

maintainers:
  - Krzysztof Kozlowski <krzk@kernel.org>

description:
  Child of the Exynos8890 PMU system controller providing CPU and cluster PMU
  power-control operations. The child uses its parent's register map.

properties:
  compatible:
    const: samsung,exynos8890-cpupm

required:
  - compatible

additionalProperties: false
...
```

## Documentation/devicetree/bindings/power/samsung,exynos8890-pm.yaml
```yaml
# SPDX-License-Identifier: (GPL-2.0-only OR BSD-2-Clause)
%YAML 1.2
---
$id: http://devicetree.org/schemas/power/samsung,exynos8890-pm.yaml#
$schema: http://devicetree.org/meta-schemas/core.yaml#

title: Samsung Exynos8890 system power-management child

maintainers:
  - Krzysztof Kozlowski <krzk@kernel.org>

description:
  Child of the Exynos8890 PMU system controller containing system-power-mode
  wakeup and idle-IP policy. The child uses its parent's main PMU register map
  and a phandle for the Mongoose-cluster PMU register block.

properties:
  compatible:
    const: samsung,exynos8890-pm

  samsung,pmu-mngs:
    $ref: /schemas/types.yaml#/definitions/phandle
    description: Phandle to the Mongoose-cluster PMU system controller.

  samsung,wakeup-mask:
    $ref: /schemas/types.yaml#/definitions/uint32-array
    minItems: 9
    maxItems: 9
    description:
      Main PMU wakeup mask for each system-power mode, in vendor mode order.

  samsung,wakeup-mask2:
    $ref: /schemas/types.yaml#/definitions/uint32-array
    minItems: 9
    maxItems: 9
    description:
      Second PMU wakeup mask for each system-power mode, in vendor mode order.

  samsung,wakeup-mask3:
    $ref: /schemas/types.yaml#/definitions/uint32-array
    minItems: 9
    maxItems: 9
    description:
      Third PMU wakeup mask for each system-power mode, in vendor mode order.

  samsung,idle-ip-names:
    $ref: /schemas/types.yaml#/definitions/string-array
    minItems: 1
    maxItems: 126
    description:
      Names whose array indices map to configurable PMU IDLE_IP bits.

  idle-ip-masks:
    type: object
    additionalProperties: false
    description: Per-power-mode lists of IDLE_IP bits required to be idle.
    patternProperties:
      '^[a-z][a-z0-9-]*$':
        type: object
        additionalProperties: false
        properties:
          samsung,mode-index:
            $ref: /schemas/types.yaml#/definitions/uint32
            maximum: 8
            description: Index in the Exynos8890 system-power-mode table.

          samsung,required-idle-ip:
            $ref: /schemas/types.yaml#/definitions/uint32-array
            minItems: 1
            maxItems: 126
            items:
              maximum: 125
            description: IDLE_IP indices which must report idle for this mode.

        required:
          - samsung,mode-index
          - samsung,required-idle-ip

required:
  - compatible
  - samsung,pmu-mngs
  - samsung,wakeup-mask
  - samsung,wakeup-mask2
  - samsung,wakeup-mask3
  - samsung,idle-ip-names

additionalProperties: false
...
```

## Documentation/devicetree/bindings/power/supply/idt,p9220.yaml
```yaml
# SPDX-License-Identifier: (GPL-2.0-only OR BSD-2-Clause)
%YAML 1.2
---
$id: http://devicetree.org/schemas/power/supply/idt,p9220.yaml#
$schema: http://devicetree.org/meta-schemas/core.yaml#

title: IDT P9220 wireless power receiver

maintainers:
  - Linux PM list <linux-pm@vger.kernel.org>

description: |
  The initial binding describes only safe receiver enumeration through the
  physical pad-detect signal. Receiver programming, charging policy and
  firmware update are outside this contract.

properties:
  compatible:
    const: idt,p9220

  reg:
    maxItems: 1

  detect-gpios:
    maxItems: 1
    description: Active-high indication that a wireless charging pad is present.

required:
  - compatible
  - reg
  - detect-gpios

additionalProperties: false

examples:
  - |
    #include <dt-bindings/gpio/gpio.h>

    i2c {
        #address-cells = <1>;
        #size-cells = <0>;

        wireless-charger@61 {
            compatible = "idt,p9220";
            reg = <0x61>;
            detect-gpios = <&gpio 5 GPIO_ACTIVE_HIGH>;
        };
    };
```

## Documentation/devicetree/bindings/power/supply/maxim,max77854-charger.yaml
```yaml
# SPDX-License-Identifier: (GPL-2.0-only OR BSD-2-Clause)
%YAML 1.2
---
$id: http://devicetree.org/schemas/power/supply/maxim,max77854-charger.yaml#
$schema: http://devicetree.org/meta-schemas/core.yaml#

title: Maxim MAX77854 battery charger

maintainers:
  - Soo-Hwan Na <whiteshell2544@naver.com>

description: |
  The MAX77854 companion PMIC contains a single-cell switch-mode charger.
  The charger is exposed as a child of the MAX77843/MAX77854 MFD because its
  secondary I2C address is owned and regmapped by the parent device.

allOf:
  - $ref: power-supply.yaml#

properties:
  compatible:
    const: maxim,max77854-charger

required:
  - compatible
  - monitored-battery

unevaluatedProperties: false
```

## Documentation/devicetree/bindings/power/supply/maxim,max77854-fuel-gauge.yaml
```yaml
# SPDX-License-Identifier: (GPL-2.0-only OR BSD-2-Clause)
%YAML 1.2
---
$id: http://devicetree.org/schemas/power/supply/maxim,max77854-fuel-gauge.yaml#
$schema: http://devicetree.org/meta-schemas/core.yaml#

title: Maxim MAX77854 fuel gauge

maintainers:
  - Krzysztof Kozlowski <krzk@kernel.org>

description: |
  The MAX77854 companion PMIC contains a MAX1704x-derived fuel-gauge block
  accessed through an internal secondary I2C address. The parent MFD creates
  the secondary client, so the child node has no reg property.

properties:
  compatible:
    const: maxim,max77854-fuel-gauge

required:
  - compatible

additionalProperties: false

examples:
  - |
    i2c {
        #address-cells = <1>;
        #size-cells = <0>;

        pmic@66 {
            compatible = "maxim,max77854";
            reg = <0x66>;

            fuel-gauge {
                compatible = "maxim,max77854-fuel-gauge";
            };
        };
    };
```

## Documentation/devicetree/bindings/reserved-memory/samsung,exynos8890-modem.yaml
```yaml
# SPDX-License-Identifier: (GPL-2.0-only OR BSD-2-Clause)
%YAML 1.2
---
$id: http://devicetree.org/schemas/reserved-memory/samsung,exynos8890-modem.yaml#
$schema: http://devicetree.org/meta-schemas/core.yaml#

title: Samsung Exynos8890 cellular modem memory

maintainers:
  - Samsung SoC Team <linux-samsung-soc@vger.kernel.org>

allOf:
  - $ref: reserved-memory.yaml

properties:
  compatible:
    const: exynos,modem_if

  reg:
    items:
      - description: 136 MiB CP boot and IPC memory

  no-map: true

required:
  - compatible
  - reg
  - no-map

unevaluatedProperties: false
```

## Documentation/devicetree/bindings/soc/samsung/samsung,exynos8890-apm.yaml
```yaml
# SPDX-License-Identifier: (GPL-2.0-only OR BSD-2-Clause)
%YAML 1.2
---
$id: http://devicetree.org/schemas/soc/samsung/samsung,exynos8890-apm.yaml#
$schema: http://devicetree.org/meta-schemas/core.yaml#

title: Samsung Exynos8890 APM DVFS ownership controller

maintainers:
  - Krzysztof Kozlowski <krzk@kernel.org>

description:
  The Exynos8890 APM Cortex-M3 can run firmware that controls DVFS through a
  mailbox. When Linux owns native clock and regulator transitions, this node
  binds the provider that keeps the APM powered down and proves exclusive
  ownership through the PMU system controller. The node is normally a child
  of that controller. The samsung,pmu phandle is a compatibility fallback for
  a standalone node.

properties:
  compatible:
    const: samsung,exynos8890-apm

  samsung,pmu:
    $ref: /schemas/types.yaml#/definitions/phandle
    description: Phandle to the Exynos8890 PMU system controller.

required:
  - compatible

additionalProperties: false

examples:
  - |
    pmu_system_controller: system-controller@105c0000 {
        compatible = "samsung,exynos8890-pmu", "samsung,exynos7-pmu", "syscon";
        reg = <0x105c0000 0x10000>;

        apm {
            compatible = "samsung,exynos8890-apm";
        };
    };
...
```

## Documentation/devicetree/bindings/soc/samsung/samsung,exynos8890-shm-ipc.yaml
```yaml
# SPDX-License-Identifier: (GPL-2.0-only OR BSD-2-Clause)
%YAML 1.2
---
$id: http://devicetree.org/schemas/soc/samsung/samsung,exynos8890-shm-ipc.yaml#
$schema: http://devicetree.org/meta-schemas/core.yaml#

title: Samsung Exynos8890 cellular modem shared memory

maintainers:
  - Samsung SoC Team <linux-samsung-soc@vger.kernel.org>

properties:
  compatible:
    const: samsung,exynos8890-shm_ipc

  memory-region:
    maxItems: 1

  shmem,ipc_offset:
    $ref: /schemas/types.yaml#/definitions/uint32
    description: Offset of the runtime IPC window within the CP reservation.
    const: 0x08000000

  shmem,ipc_size:
    $ref: /schemas/types.yaml#/definitions/uint32
    description: Size of the runtime IPC window.
    const: 0x00800000

required:
  - compatible
  - memory-region
  - shmem,ipc_offset
  - shmem,ipc_size

additionalProperties: false
```

## Documentation/devicetree/bindings/soc/samsung/samsung,exynos8890-ss310ap-cpctl.yaml
```yaml
# SPDX-License-Identifier: (GPL-2.0-only OR BSD-2-Clause)
%YAML 1.2
---
$id: http://devicetree.org/schemas/soc/samsung/samsung,exynos8890-ss310ap-cpctl.yaml#
$schema: http://devicetree.org/meta-schemas/core.yaml#

title: Samsung Exynos8890 SS310AP modem control plane

maintainers:
  - Krzysztof Kozlowski <krzk@kernel.org>

description: |
  Control plane for the SS310AP modem integrated in Exynos8890. It owns CP
  power/reset secure-monitor calls, the CP failure and watchdog interrupts,
  calibration SYSRAM, AP/CP mailbox clients, and the reserved-memory geometry.

properties:
  compatible:
    const: samsung,exynos8890-ss310ap-cpctl

  reg:
    maxItems: 1

  reg-names:
    items:
      - const: sysram

  interrupts:
    minItems: 2
    maxItems: 2

  interrupt-names:
    items:
      - const: cp-fail
      - const: cp-watchdog

  samsung,pmu:
    $ref: /schemas/types.yaml#/definitions/phandle

  samsung,mbox-syscon:
    $ref: /schemas/types.yaml#/definitions/phandle
    description: Syscon exposing the 64 mailbox ISSR words.

  mboxes:
    minItems: 16
    maxItems: 16

  mailbox-names:
    minItems: 16
    maxItems: 16

  memory-region:
    maxItems: 1

  revision-gpios:
    minItems: 4
    maxItems: 4

  samsung,dual-sim:
    type: boolean

required:
  - compatible
  - reg
  - reg-names
  - interrupts
  - interrupt-names
  - samsung,pmu
  - samsung,mbox-syscon
  - mboxes
  - mailbox-names
  - memory-region
  - revision-gpios

additionalProperties: false

examples:
  - |
    #include <dt-bindings/gpio/gpio.h>
    #include <dt-bindings/interrupt-controller/arm-gic.h>

    modem-control@20c7800 {
        compatible = "samsung,exynos8890-ss310ap-cpctl";
        reg = <0x020c7800 0x800>;
        reg-names = "sysram";
        interrupts = <GIC_SPI 21 0>, <GIC_SPI 96 0>;
        interrupt-names = "cp-fail", "cp-watchdog";
        samsung,pmu = <&pmu_system_controller>;
        samsung,mbox-syscon = <&mailbox>;
        mboxes = <&mailbox 0>, <&mailbox 1>, <&mailbox 2>, <&mailbox 3>,
                  <&mailbox 4>, <&mailbox 5>, <&mailbox 6>, <&mailbox 7>,
                  <&mailbox 8>, <&mailbox 9>, <&mailbox 10>, <&mailbox 11>,
                  <&mailbox 12>, <&mailbox 13>, <&mailbox 14>, <&mailbox 15>;
        mailbox-names = "doorbell0", "doorbell1", "doorbell2", "doorbell3",
                        "doorbell4", "doorbell5", "doorbell6", "doorbell7",
                        "doorbell8", "doorbell9", "doorbell10", "doorbell11",
                        "doorbell12", "doorbell13", "doorbell14", "doorbell15";
        memory-region = <&modem_mem>;
        revision-gpios = <&gpf2 0 GPIO_ACTIVE_HIGH>,
                         <&gpf2 1 GPIO_ACTIVE_HIGH>,
                         <&gpf2 2 GPIO_ACTIVE_HIGH>,
                         <&gpf2 3 GPIO_ACTIVE_HIGH>;
    };
```

## Documentation/devicetree/bindings/soc/samsung/sec-modem,modem-pdata.yaml
```yaml
# SPDX-License-Identifier: (GPL-2.0-only OR BSD-2-Clause)
%YAML 1.2
---
$id: http://devicetree.org/schemas/soc/samsung/sec-modem,modem-pdata.yaml#
$schema: http://devicetree.org/meta-schemas/core.yaml#

title: Samsung SIPC5 SS310 modem interface

maintainers:
  - Samsung SoC Team <linux-samsung-soc@vger.kernel.org>

description: |
  Board data for the Exynos8890 integrated SS310 cellular processor, including
  its PMU and SYSRAM resources, mailbox word/interrupt assignments and SIPC5
  userspace endpoints.

properties:
  compatible:
    const: sec_modem,modem_pdata

  reg:
    maxItems: 1

  interrupts:
    minItems: 2
    maxItems: 2

  samsung,syscon-phandle:
    $ref: /schemas/types.yaml#/definitions/phandle
    description: Exynos PMU syscon used for CP power and reset control.

  gpios:
    minItems: 4
    maxItems: 4

  status: true

  mif,name:
    $ref: /schemas/types.yaml#/definitions/string
    description: Modem model name.
  mif,link_name:
    $ref: /schemas/types.yaml#/definitions/string
    description: Shared-memory link name.

  mif,ap_clk_table:
    $ref: /schemas/types.yaml#/definitions/uint32-array
    description: Supported application-processor QoS rates in kHz.
  mif,mif_clk_table:
    $ref: /schemas/types.yaml#/definitions/uint32-array
    description: Supported memory-interface QoS rates in kHz.
  mif,int_clk_table:
    $ref: /schemas/types.yaml#/definitions/uint32-array
    description: Supported internal-bus QoS rates in kHz.

  iodevs:
    type: object
    additionalProperties: false
    patternProperties:
      '^io_device_[0-9]+$':
        type: object
        additionalProperties: false
        properties:
          iod,name:
            $ref: /schemas/types.yaml#/definitions/string
            description: SIPC endpoint name.
          iod,app:
            $ref: /schemas/types.yaml#/definitions/string
            description: Userspace endpoint owner.
          iod,option_region:
            $ref: /schemas/types.yaml#/definitions/string
            description: Optional sales-region restriction.
        patternProperties:
          '^iod,(id|format|io_type|links|attrs|ul_num_buffers|ul_buffer_size|dl_num_buffers|dl_buffer_size)$':
            $ref: /schemas/types.yaml#/definitions/uint32
        required:
          - iod,name
          - iod,id
          - iod,format
          - iod,io_type
          - iod,links
          - iod,attrs

patternProperties:
  '^mif,(int_ap2cp|irq_cp2ap)_[a-z0-9_]+$':
    $ref: /schemas/types.yaml#/definitions/uint32
  '^mif,(modem_net|modem_type|use_handover|ipc_version|link_types|link_attrs|num_iodevs)$':
    $ref: /schemas/types.yaml#/definitions/uint32
  '^mbx_(ap2cp|cp2ap)_[a-z0-9_]+$':
    $ref: /schemas/types.yaml#/definitions/uint32

required:
  - compatible
  - reg
  - interrupts
  - samsung,syscon-phandle
  - gpios
  - mif,name
  - mif,modem_type
  - mif,ipc_version
  - mif,link_types
  - mif,num_iodevs
  - iodevs

additionalProperties: false
```
