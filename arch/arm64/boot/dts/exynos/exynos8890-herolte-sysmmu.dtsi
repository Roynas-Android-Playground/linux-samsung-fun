// SPDX-License-Identifier: GPL-2.0 OR BSD-3-Clause
/*
 * Samsung Galaxy S7 (herolte) MFC System MMU bring-up.
 *
 * Keep the MFC power domain on while the Exynos8890-specific power-off and
 * local CMU/Q-channel sequencing is still being brought upstream. This first
 * stage only exposes the two MFC System MMUs; the MFC client is wired later.
 */

#include <dt-bindings/clock/samsung,exynos8890-cmu.h>
#include <dt-bindings/interrupt-controller/arm-gic.h>

&soc {
	pd_mfc: power-domain@105c4180 {
		compatible = "samsung,exynos8890-mfc-pd";
		reg = <0x105c4180 0x20>;
		#power-domain-cells = <0>;
		label = "MFC";
	};

	sysmmu_mfc0_0: iommu@152d0000 {
		compatible = "samsung,exynos-sysmmu";
		reg = <0x152d0000 0x2000>;
		interrupts = <GIC_SPI 290 IRQ_TYPE_LEVEL_HIGH>;

		clocks = <&cmu_top CLK_GOUT_TOP_ACLK_MFC_600>;
		clock-names = "sysmmu";
		power-domains = <&pd_mfc>;

		#iommu-cells = <0>;
	};

	sysmmu_mfc0_1: iommu@152f0000 {
		compatible = "samsung,exynos-sysmmu";
		reg = <0x152f0000 0x2000>;
		interrupts = <GIC_SPI 291 IRQ_TYPE_LEVEL_HIGH>;

		clocks = <&cmu_top CLK_GOUT_TOP_ACLK_MFC_600>;
		clock-names = "sysmmu";
		power-domains = <&pd_mfc>;

		#iommu-cells = <0>;
	};
};
